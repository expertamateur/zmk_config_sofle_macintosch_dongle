## config/boards/arm/sofle_dongle/Kconfig
```kconfig
# Copyright (c) 2025 ZitaoTech
# SPDX-License-Identifier: MIT

config BOARD_DONGLE_MASTER
    bool

config BOARD_LF_SLAVER
    bool

config BOARD_LF_MASTER
    bool

config BOARD_RT_SLAVER
    bool

config BOARD_RT_MASTER
    bool
```

## config/boards/arm/sofle_dongle/Kconfig.board
```kconfig
# Copyright (c) 2025 ZitaoTech
# SPDX-License-Identifier: MIT
#
# 五块板 = 「半别 × 角色」：
#   dongle_master  独立的 dongle，当中央（有 dongle 的那套接线）
#   lf_/rt_slaver  左/右半当外设（挂在 dongle 或对侧主控下面）
#   lf_/rt_master  左/右半当主控（没有 dongle 时自己连主机）
# 角色带来的差异见 Kconfig.defconfig，硬件差异见 lf.dtsi / rt.dtsi。

config BOARD_DONGLE_MASTER
    bool "sofle dongle (dongle, central)"
    depends on SOC_NRF52840_QIAA

config BOARD_LF_SLAVER
    bool "sofle dongle left half (peripheral)"
    depends on SOC_NRF52840_QIAA

config BOARD_LF_MASTER
    bool "sofle dongle left half (central, no dongle)"
    depends on SOC_NRF52840_QIAA

config BOARD_RT_SLAVER
    bool "sofle dongle right half (peripheral)"
    depends on SOC_NRF52840_QIAA

config BOARD_RT_MASTER
    bool "sofle dongle right half (central, no dongle)"
    depends on SOC_NRF52840_QIAA

menu "A320 Trackpad Setting"

config A320_TRACKPAD_SCROLL_INTERVAL
    int "Trackpad scroll in miliseconds"
    default 50
    range 0 200
    help
      The bigger this value, the slower the trackpad scrolls

config A320_LOG_LEVEL
	int "Log Level for Touch"
	default 4

config A320
	bool "A320 Driver"
	depends on I2C && GPIO
	help
	  Projected capacitive trackpad/touchscreen controller.

config INPUT_A320_INIT_PRIORITY
  int "A320 Initialization Priority"
  default 90

endmenu
```

## config/boards/arm/sofle_dongle/Kconfig.defconfig
```kconfig
#
# Copyright (c) 2025 ZitaoTech
# SPDX-License-Identifier: MIT
#

# =========================================================
# 中央（主控）：dongle，或没有 dongle 时当主控的那半。
# 屏幕显示什么由 lpm_view 按这个角色切（status.c 显示连了哪些设备/电量/层，
# 见 lpm_view/CMakeLists.txt），跟官方无 dongle 仓库一致。
# =========================================================
if BOARD_DONGLE_MASTER || BOARD_LF_MASTER || BOARD_RT_MASTER

config ZMK_KEYBOARD_NAME
    default "SOFLE_DONGLE"

config ZMK_SPLIT_ROLE_CENTRAL
    default y

endif # 中央

# =========================================================
# 五块板共有
# =========================================================
if BOARD_DONGLE_MASTER || BOARD_LF_SLAVER || BOARD_LF_MASTER || BOARD_RT_SLAVER || BOARD_RT_MASTER

if ZMK_BACKLIGHT

config PWM
    default y

config LED_PWM
    default y

endif # ZMK_BACKLIGHT

config BOARD
    default "SOFLE_DONGLE"

config ZMK_SPLIT
    default y

config ZMK_SPLIT_PERIPHERAL_HID_INDICATORS
    default y

config BT_CTLR
    default BT

endif # 五块板

# =========================================================
# 左右半「模块插座」引脚（Kconfig 那一半）
# =========================================================
#
# 「插座上的哪根线接到 MCU 的哪只脚」是板子焊死的，插的是轨迹球/触摸板/小红点
# 由 shield 决定（enable 在 shield 的 overlay 里），所以引脚号按「半」给默认值：
# 同侧的 master / slaver 硬件完全相同，共享一份。设备树那一半（pinctrl 的 psels）
# 在 lf.dtsi / rt.dtsi 里。引脚表见 MODULAR_POINTER_ANALYSIS.md §4。
#
# 这里是 Kconfig 默认值，不是强制值：想改可以在自己的 .conf 里覆盖
# （Kconfig 片段优先级高于默认值，见 CLAUDE.md 那套「按板名/目录名合并 conf」）。
# 缺资料的那几个座子保持 shield 里的默认值 -1，编出来的固件会被驱动 #error
# 拒绝（见 MODULAR_POINTER_ANALYSIS.md §4.4）。

if BOARD_LF_SLAVER || BOARD_LF_MASTER

# 左座（MODULAR_POINTER_ANALYSIS.md §4.1）
#
# 轨迹球：四根方向线
#   UP P0.05 · LEFT P0.12 · DOWN P1.09 · RIGHT P0.27
config BBTRACKBALL_UP_GPIO_PORT
    default 0

config BBTRACKBALL_UP_GPIO_PIN
    default 5

config BBTRACKBALL_LEFT_GPIO_PORT
    default 0

config BBTRACKBALL_LEFT_GPIO_PIN
    default 12

# 四根里只有 DOWN 在 gpio1，其余三根在 gpio0
config BBTRACKBALL_DOWN_GPIO_PORT
    default 1

config BBTRACKBALL_DOWN_GPIO_PIN
    default 9

config BBTRACKBALL_RIGHT_GPIO_PORT
    default 0

config BBTRACKBALL_RIGHT_GPIO_PIN
    default 27

# 触摸板：MOTION 中断线（和轨迹球的 UP 是同一根线）
config A320_MOTION_GPIO_PORT
    default 0

config A320_MOTION_GPIO_PIN
    default 5

# 左座的小红点引脚源码里没有 → 保持默认 -1，
# 编 lf_* + trackpoint 时驱动会 #error 拒绝。

endif # 左半

if BOARD_RT_SLAVER || BOARD_RT_MASTER

# 右座（MODULAR_POINTER_ANALYSIS.md §4.2）
#
# 小红点：MOTION 中断线 P0.14
config TRACKPOINT_MOTION_GPIO_PORT
    default 0

config TRACKPOINT_MOTION_GPIO_PIN
    default 14

# 右座的轨迹球/触摸板引脚源码里没有 → 保持默认 -1，
# 编 rt_* + ball/pad 时驱动会 #error 拒绝。

endif # 右半
```

## config/boards/shields/bbtrackpad/Kconfig.shield
```kconfig
# Copyright (c) 2022 The ZMK Contributors
# SPDX-License-Identifier: MIT

config SHIELD_BBTRACKPAD
    def_bool $(shields_list_contains,bbtrackpad)

menu "A320 Trackpad Setting"

config A320_TRACKPAD_SCROLL_INTERVAL
    int "Trackpad scroll in miliseconds"
    default 50
    range 0 200
    help
      The bigger this value, the slower the trackpad scrolls

config A320_LOG_LEVEL
	int "Log Level for Touch"
	default 4

config A320
	bool "A320 Driver"
	depends on I2C && GPIO
	help
	  Projected capacitive trackpad/touchscreen controller.

config INPUT_A320_INIT_PRIORITY
  int "A320 Initialization Priority"
  default 90

endmenu


menu "A320 Advanced Settings"

config A320_EXPONENTIAL
    bool "Enable A320 exponential acceleration"
    default y
    help
      Enable exponential acceleration for A320 movement,
      similar to trackball behavior.

config A320_MOUSE_KEY_POSITION_1
    int "Key position 1 that switches the trackpad to mouse movement"
    default 61
    help
      ZMK position code. While this key (or _2) is held, the trackpad
      reports REL_X/REL_Y; otherwise it reports the scroll wheel.

config A320_MOUSE_KEY_POSITION_2
    int "Key position 2 that switches the trackpad to mouse movement"
    default 62
    help
      See A320_MOUSE_KEY_POSITION_1.

config A320_SCROLL_X_DIR
    int "Scroll X direction multiplier (1 for normal, -1 for inverted)"
    default 1

config A320_SCROLL_Y_DIR
    int "Scroll Y direction multiplier (1 for normal, -1 for inverted)"
    default 1

config A320_DOMINANT_NUMERATOR
    int "Dominant axis numerator for accidental touch prevention"
    default 3

config A320_DOMINANT_DENOMINATOR
    int "Dominant axis denominator for accidental touch prevention"
    default 2

config A320_MOUSE_BASE_SPEED_PERCENT
    int "Mouse base speed (Percentage, 50 = 0.5)"
    default 150

config A320_MOUSE_SENS_BASE_PERCENT
    int "Mouse sensitivity base (Percentage, 40 = 0.3)"
    default 40

config A320_MOUSE_SENS_STEP_PERCENT
    int "Mouse sensitivity step per LED brightness (Percentage, 1 = 0.01)"
    default 1

config CUSTOM_LED_BRT_UP_POS
    int "Custom LED Brightness UP key position"
    default 49

config CUSTOM_LED_BRT_DOWN_POS
    int "Custom LED Brightness DOWN key position"
    default 50

config CUSTOM_LED_BRT_DEFAULT
    int "Custom LED Default Brightness (10-255)"
    default 128
    help
      Default brightness level of the Dongle LED on boot.

config CUSTOM_LED_BRT_STEP
    int "Custom LED Brightness Adjustment Step"
    default 25
    help
      The amount of brightness added or subtracted per key press.

endmenu

menu "A320 Socket Pins"

# 模块插座上的 MOTION 中断线接到哪只脚。I2C 那两根是设备树的事
# （config/boards/arm/sofle_dongle/lf.dtsi），这里只管驱动自己配的 GPIO。
# 按「板」给值：左半在 Kconfig.defconfig 的 `if BOARD_LF_*` 段。
# 目前只有左座数据（MODULAR_POINTER_ANALYSIS.md §4.1）：MOTION P0.05。

config A320_MOTION_GPIO_PORT
    int "GPIO port number (0 or 1) of the trackpad MOTION line"
    default -1
    help
      -1 means "not defined for this side yet"; the driver then fails the build.

config A320_MOTION_GPIO_PIN
    int "GPIO pin number of the trackpad MOTION line"
    default -1

endmenu
```

## config/boards/shields/left_bbtrackball_dongle/Kconfig.shield
```kconfig
# Copyright (c) 2022 The ZMK Contributors
# SPDX-License-Identifier: MIT

config SHIELD_LEFT_BBTRACKBALL_DONGLE
    def_bool $(shields_list_contains,left_bbtrackball_dongle)

menu "BBtrackball Setting"


config BBtrackball_lighted_when_moved
	bool "BBtrackball led lighted when moved"

config BBtrackball_max_brightness
    int "BBtrackball brightness when moved"
    default 20
    range 0 100
    help
      The brightness when you move the BB trackball

config BBTRACKBALL_MOUSE_KEY_POSITION_1
    int "Key position 1 that switches the trackball to mouse movement"
    default 61
    help
      ZMK position code. While this key (or _2) is held, the trackball
      reports REL_X/REL_Y; otherwise it reports the scroll wheel.
      Defaults 61/62 are the two thumb keys on the mouse layer.

config BBTRACKBALL_MOUSE_KEY_POSITION_2
    int "Key position 2 that switches the trackball to mouse movement"
    default 62
    help
      See BBTRACKBALL_MOUSE_KEY_POSITION_1.

endmenu

menu "BBtrackball Socket Pins"

# 模块插座上那四根方向线接到哪只脚。引脚不再写死在驱动源码里，值放在
# config/sofle_dongle_left.conf / config/sofle_dongle_right.conf。
#
# default -1 = 「这一侧的引脚还没有定义」。驱动里 #if 判到 -1 会直接
# #error，而不是默默用 0 号脚编出一份接不上的固件。
#
# 目前只有左座数据（MODULAR_POINTER_ANALYSIS.md §4.1）：
#   UP P0.05 · LEFT P0.12 · DOWN P1.09 · RIGHT P0.27
# 右座资料到位后，在 config/sofle_dongle_right.conf 里补上这里八项的值。

config BBTRACKBALL_UP_GPIO_PORT
    int "GPIO port number (0 or 1) of the trackball UP line"
    default -1
    help
      -1 means "not defined for this side yet".

config BBTRACKBALL_UP_GPIO_PIN
    int "GPIO pin number of the trackball UP line"
    default -1

config BBTRACKBALL_LEFT_GPIO_PORT
    int "GPIO port number (0 or 1) of the trackball LEFT line"
    default -1
    help
      -1 means "not defined for this side yet".

config BBTRACKBALL_LEFT_GPIO_PIN
    int "GPIO pin number of the trackball LEFT line"
    default -1

config BBTRACKBALL_DOWN_GPIO_PORT
    int "GPIO port number (0 or 1) of the trackball DOWN line"
    default -1
    help
      -1 means "not defined for this side yet".
      On the left socket this one is the only line on port 1.

config BBTRACKBALL_DOWN_GPIO_PIN
    int "GPIO pin number of the trackball DOWN line"
    default -1

config BBTRACKBALL_RIGHT_GPIO_PORT
    int "GPIO port number (0 or 1) of the trackball RIGHT line"
    default -1
    help
      -1 means "not defined for this side yet".

config BBTRACKBALL_RIGHT_GPIO_PIN
    int "GPIO pin number of the trackball RIGHT line"
    default -1

endmenu
```

## config/boards/shields/left_bbtrackpad_dongle/Kconfig.shield
```kconfig
# Copyright (c) 2022 The ZMK Contributors
# SPDX-License-Identifier: MIT

config SHIELD_LEFT_BBTRACKPAD_DONGLE
    def_bool $(shields_list_contains,left_bbtrackpad_dongle)

menu "A320 Trackpad Setting"

config A320_TRACKPAD_SCROLL_INTERVAL
    int "Trackpad scroll in miliseconds"
    default 50
    range 0 200
    help
      The bigger this value, the slower the trackpad scrolls

config A320_LOG_LEVEL
	int "Log Level for Touch"
	default 4

config A320
	bool "A320 Driver"
	depends on I2C && GPIO
	help
	  Projected capacitive trackpad/touchscreen controller.

config INPUT_A320_INIT_PRIORITY
  int "A320 Initialization Priority"
  default 90

endmenu


menu "A320 Advanced Settings"

config A320_EXPONENTIAL
    bool "Enable A320 exponential acceleration"
    default y
    help
      Enable exponential acceleration for A320 movement,
      similar to trackball behavior.

config A320_MOUSE_KEY_POSITION_1
    int "Key position 1 that switches the trackpad to mouse movement"
    default 61
    help
      ZMK position code. While this key (or _2) is held, the trackpad
      reports REL_X/REL_Y; otherwise it reports the scroll wheel.

config A320_MOUSE_KEY_POSITION_2
    int "Key position 2 that switches the trackpad to mouse movement"
    default 62
    help
      See A320_MOUSE_KEY_POSITION_1.

config A320_SCROLL_X_DIR
    int "Scroll X direction multiplier (1 for normal, -1 for inverted)"
    default 1

config A320_SCROLL_Y_DIR
    int "Scroll Y direction multiplier (1 for normal, -1 for inverted)"
    default 1

config A320_DOMINANT_NUMERATOR
    int "Dominant axis numerator for accidental touch prevention"
    default 3

config A320_DOMINANT_DENOMINATOR
    int "Dominant axis denominator for accidental touch prevention"
    default 2

config A320_MOUSE_BASE_SPEED_PERCENT
    int "Mouse base speed (Percentage, 50 = 0.5)"
    default 150

config A320_MOUSE_SENS_BASE_PERCENT
    int "Mouse sensitivity base (Percentage, 40 = 0.3)"
    default 40

config A320_MOUSE_SENS_STEP_PERCENT
    int "Mouse sensitivity step per LED brightness (Percentage, 1 = 0.01)"
    default 1

config CUSTOM_LED_BRT_UP_POS
    int "Custom LED Brightness UP key position"
    default 49

config CUSTOM_LED_BRT_DOWN_POS
    int "Custom LED Brightness DOWN key position"
    default 50

config CUSTOM_LED_BRT_DEFAULT
    int "Custom LED Default Brightness (10-255)"
    default 128
    help
      Default brightness level of the Dongle LED on boot.

config CUSTOM_LED_BRT_STEP
    int "Custom LED Brightness Adjustment Step"
    default 25
    help
      The amount of brightness added or subtracted per key press.

endmenu
```
