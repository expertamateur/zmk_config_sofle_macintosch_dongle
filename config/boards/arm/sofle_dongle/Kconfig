## config/boards/shields/right_trackpoint_dongle/Kconfig.shield
```kconfig
# Copyright (c) 2022 The ZMK Contributors
# SPDX-License-Identifier: MIT

config SHIELD_RIGHT_TRACKPOINT_DONGLE
    def_bool $(shields_list_contains,right_trackpoint_dongle)

menu "TrackPoint Advanced Settings"

config TRACKPOINT_EXPONENTIAL
    bool "Enable TrackPoint exponential acceleration"
    default y
    help
      Enable exponential acceleration for TrackPoint movement,
      similar to trackball behavior.

config TRACKPOINT_MOUSE_KEY_POSITION_1
    int "Key position 1 that switches the trackpoint to mouse movement"
    default 61
    help
      ZMK position code. While this key (or _2) is held, the trackpoint
      reports REL_X/REL_Y; otherwise it reports the scroll wheel.

config TRACKPOINT_MOUSE_KEY_POSITION_2
    int "Key position 2 that switches the trackpoint to mouse movement"
    default 62
    help
      See TRACKPOINT_MOUSE_KEY_POSITION_1.

config TRACKPOINT_SCROLL_X_DIR
    int "Scroll X direction multiplier (1 for normal, -1 for inverted)"
    default 1

config TRACKPOINT_SCROLL_Y_DIR
    int "Scroll Y direction multiplier (1 for normal, -1 for inverted)"
    default 1

config TRACKPOINT_SCROLL_DEADZONE
    int "Scroll deadzone"
    default 1
    help
      Deadzone to filter out slight hand tremors.

config TRACKPOINT_SCROLL_INPUT_MAX
    int "Scroll input max"
    default 128

config TRACKPOINT_SCROLL_DIVISOR_SLOW
    int "Scroll divisor slow (Fine-grained control)"
    default 24

config TRACKPOINT_SCROLL_DIVISOR_FAST
    int "Scroll divisor fast (Max speed limit)"
    default 6

config TRACKPOINT_DOMINANT_NUMERATOR
    int "Dominant axis numerator for accidental touch prevention"
    default 3

config TRACKPOINT_DOMINANT_DENOMINATOR
    int "Dominant axis denominator for accidental touch prevention"
    default 2

config TRACKPOINT_MOUSE_BASE_SPEED_PERCENT
    int "Mouse base speed (Percentage, 50 = 0.5)"
    default 50

config TRACKPOINT_MOUSE_SENS_BASE_PERCENT
    int "Mouse sensitivity base (Percentage, 30 = 0.3)"
    default 30

config TRACKPOINT_MOUSE_SENS_STEP_PERCENT
    int "Mouse sensitivity step per LED brightness (Percentage, 1 = 0.01)"
    default 1

config CUSTOM_LED_BRT_UP_POS
    int "Custom LED Brightness UP key position"
    default 49

config CUSTOM_LED_BRT_DOWN_POS
    int "Custom LED Brightness DOWN key position"
    default 50

config CUSTOM_LED_BRT_DEFAULT
    int "Custom LED Default Brightness (10-255)"
    default 128
    help
      Default brightness level of the Dongle LED on boot.

config CUSTOM_LED_BRT_STEP
    int "Custom LED Brightness Adjustment Step"
    default 25
    help
      The amount of brightness added or subtracted per key press.

endmenu

menu "TrackPoint Socket Pins"

# 模块插座上的 MOTION 中断线接到哪只脚。I2C 那两根是设备树的事
# （config/sofle_dongle_right.overlay），这里只管驱动自己配的 GPIO。
# 只有右座数据（MODULAR_POINTER_ANALYSIS.md §4.2）：MOTION P0.14。

config TRACKPOINT_MOTION_GPIO_PORT
    int "GPIO port number (0 or 1) of the trackpoint MOTION line"
    default -1
    help
      -1 means "not defined for this side yet"; the driver then fails the build.

config TRACKPOINT_MOTION_GPIO_PIN
    int "GPIO pin number of the trackpoint MOTION line"
    default -1

endmenu
```
